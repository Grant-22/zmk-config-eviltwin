## config/boards/shields/eviltwin/Kconfig.defconfig
```kconfig
# Copyright (c) 2022 The ZMK Contributors
# SPDX-License-Identifier: MIT

if SHIELD_eviltwin || SHIELD_eviltwin_LEFTY

config ZMK_KEYBOARD_NAME
    default "eviltwin"

endif
```

## config/boards/shields/eviltwin/Kconfig.shield
```kconfig
# Copyright (c) 2022 The ZMK Contributors
# SPDX-License-Identifier: MIT

config SHIELD_eviltwin
    def_bool $(shields_list_contains,eviltwin)

config SHIELD_eviltwin_LEFTY
    def_bool $(shields_list_contains,eviltwin_lefty)
```
